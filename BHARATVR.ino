#define START_CMD_CHAR '>'
#define END_CMD_CHAR '\n'
#define DIV_CMD_CHAR ','

#define DEBUG 1 

Servo panVariable;
Servo tiltVariable;

// Center servos
inttiltValue = 90; 
intpanValue =90; 


String inText;
float Constant1, Constant2, Constant3;

void setup() {

  // Attach servo objects to Arduino pins
  panVariable.attach(11); 
  tiltVariable.attach(10);

  Serial.begin(9600); 
  Serial.println("Android Sensor Type No: ");
  Serial.println("1- ACCELEROMETER  (m/s^2 - X,Y,Z)");
  Serial.println("2- MAGNETIC_FIELD (uT - X,Y,Z)");
  Serial.println("3- ORIENTATION (yaw, pitch, roll)");
  
  Serial.flush();
}


void loop()
{
  Serial.flush();
  intinCommand = 0;
  intsensorType = 0;
  unsigned long CountVar = 0;

  char getChar = ' ';  //read serial

  // if serial empty, return to loop().
  if (Serial.available() < 1) return; 


  // parse incoming command start flag
  getChar = Serial.read();
  if (getChar != START_CMD_CHAR) return; // if no command start flag, return to loop().

  // parse incoming pin# and value 
  sensorType = Serial.parseInt(); 
  CountVar = Serial.parseInt();  
  Constant1 = Serial.parseFloat();  // 1st sensor value
  Constant2 = Serial.parseFloat();  // 2rd sensor value 
  Constant3 = Serial.parseFloat();  // 3rd sensor value

  // Print Sensoduino readings on Computer
  if (DEBUG) {
    Serial.print("Sensor type: ");
    Serial.println(sensorType);
    Serial.print("Sensor log#: ");
    Serial.println(CountVar);
    Serial.print("Val[0]: ");
    Serial.println(Constant1);
    Serial.print("Val[1]: ");
    Serial.println(Constant2);
    
    Serial.println("-----------------------");
    delay(10);
  }


  if (sensorType !=1) return;   

  panValue = Constant1; //X sensor 
  tiltValue = Constant2;  // Y sensor 

  tiltValue = map(tiltValue, 10, -10, 0, 179);   // Mapping y value of Accelerometer to tilt Angle
   tiltVariable.write(tiltValue);  // Create Required Files
   delay(10);

  panValue = map(panValue, -10, 10, 0, 179);  //Mapping X value of Accelerometer to pan Angle
  panVariable.write(panValue);     //Create Required Files
  delay(10); 
}

